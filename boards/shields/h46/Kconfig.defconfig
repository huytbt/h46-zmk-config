## boards/shields/h46/Kconfig.defconfig
```kconfig
# Copyright (c) 2025
# SPDX-License-Identifier: MIT

if SHIELD_H46

config ZMK_KEYBOARD_NAME
    default "H46"

endif
```

## boards/shields/h46/Kconfig.shield
```kconfig
# Copyright (c) 2025
# SPDX-License-Identifier: MIT

config SHIELD_H46
    def_bool $(shields_list_contains,h46)
```
